## arch/arm/mach-quest/Kconfig
```kconfig
# SPDX-License-Identifier: GPL-2.0-or-later
# Copyright (c) 2026 ninozhang001@gmail.com

if TARGET_QRK3588

config SYS_SOC
	default "quest"

config SYS_VENDOR
	default "quest"

config SYS_BOARD
	default "qrk3588"

config TEXT_BASE
	default 0x00200000

config SYS_MALLOC_LEN
	default 0x800000

config SYS_MALLOC_F_LEN
	default 0x4000

config SYS_LOAD_ADDR
	default 0x01400000

config CUSTOM_SYS_INIT_SP_ADDR
	default 0x01200000

config NR_DRAM_BANKS
	default 2

config MMC_SDHCI_QRK3588
	bool "Quest QRK3588 SDHCI support"
	depends on DM_MMC && BLK
	select MMC_SDHCI
	select MMC_SDHCI_SDMA
	default y
	help
	  Enable the Quest QRK3588 eMMC host driver. The driver uses U-Boot's
	  generic SDHCI MMC command and data path. Platform clock, reset, and
	  signal-routing providers must be available before the eMMC DT node is
	  enabled.

config CLK_QRK3588
	bool "Quest QRK3588 clock controller"
	select CLK
	default y
	help
	  Enable the Quest QRK3588 clock controller.

config RESET_QRK3588
	bool "Quest QRK3588 reset controller"
	depends on CLK_QRK3588
	select DM_RESET
	default y
	help
	  Enable the Quest QRK3588 reset controller.

config GPIO_QRK3588
	bool "Quest QRK3588 GPIO controller"
	depends on CLK_QRK3588
	select DM_GPIO
	default y
	help
	  Enable Driver Model GPIO support for the five QRK3588 GPIO banks.

config PINCTRL_QRK3588
	bool "Quest QRK3588 pin controller"
	select PINCTRL
	select PINCTRL_GENERIC
	select PINMUX
	default y
	help
	  Enable the Quest QRK3588 pin controller. The initial implementation
	  provides the eMMC pin-mux group.

config QRK3588_SECURE_OS
	bool "Authenticate Linux and DTB before booting"
	default n
	depends on CMDLINE
	select EVENT
	select FIT
	select FIT_SIGNATURE
	select RSA
	select RSA_VERIFY
	select SHA256
	select CMD_BOOTM
	select CMD_BOOTI
	select LMB
	help
	  Optional OS authentication, independent of TF-A firmware authentication.
	  Leave disabled for the normal shell and raw Linux/rootfs boot paths.
	  Boot only conf-secure from the fixed eMMC FIT slot. A required
	  configuration key must be embedded in the authenticated control DTB.
	  Kernel parameters come from the authenticated Linux DTB. Failure
	  stops boot; no shell or environment-controlled fallback is available.

endif
```

## configs/qrk3588_debug_defconfig
```kconfig
# SPDX-License-Identifier: GPL-2.0-or-later
# Copyright (c) 2026 ninozhang001@gmail.com

CONFIG_ARM=y
CONFIG_TARGET_QRK3588=y
CONFIG_DEFAULT_DEVICE_TREE="qrk3588"
CONFIG_BOARD_LATE_INIT=y
CONFIG_HUSH_PARSER=y
CONFIG_BOOTSTD_FULL=y
CONFIG_BOOTSTD_DEFAULTS=y
CONFIG_DEBUG_UART_BASE=0xfeb50000
CONFIG_DEBUG_UART_CLOCK=24000000

# PSCI not implement yet. Add this for skipping do_psci_probe.
# CONFIG_PSCI_RESET is not set

CONFIG_DEBUG_UART=y
CONFIG_CC_OPTIMIZE_FOR_DEBUG=y

# Turn it on will cause build failures and runtime panics.
# CONFIG_EFI_LOADER is not set

CONFIG_BAUDRATE=1500000
CONFIG_CMD_CLK=y
CONFIG_CMD_DM=y
CONFIG_CMD_GPT=y
CONFIG_CMD_MMC=y
CONFIG_CMD_PART=y
CONFIG_SHA256=y
CONFIG_PARTITION_TYPE_GUID=y
CONFIG_ENV_IS_IN_MMC=y
CONFIG_ENV_REDUNDANT=y
CONFIG_ENV_OFFSET=0x01600000
CONFIG_ENV_OFFSET_REDUND=0x01610000
CONFIG_ENV_SIZE=0x00010000
CONFIG_ENV_MMC_DEVICE_INDEX=0
CONFIG_ENV_MMC_EMMC_HW_PARTITION=0
CONFIG_DM_SERIAL=y
CONFIG_DEBUG_UART_SHIFT=2
CONFIG_SYS_NS16550=y
CONFIG_GPIO_QRK3588=y
CONFIG_PINCTRL_QRK3588=y
CONFIG_RESET_QRK3588=y
CONFIG_MMC_SDHCI_QRK3588=y
CONFIG_PCI=y
CONFIG_PCI_INIT_R=y
CONFIG_PCIE_DW_QRK3588=y
CONFIG_RTL8169=y
# RTL descriptors share cache lines; allocate them from the uncached pool.
CONFIG_SYS_HAS_NONCACHED_MEMORY=y
CONFIG_NET_RANDOM_ETHADDR=y
CONFIG_CMD_PCI=y
CONFIG_CMD_PING=y
CONFIG_CMD_BOOTI=y
CONFIG_CMD_TFTPBOOT=y
CONFIG_CMD_DHCP=y
```
